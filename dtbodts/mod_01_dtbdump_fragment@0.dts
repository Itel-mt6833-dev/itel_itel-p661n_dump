/dts-v1/;

/ {

	__fixups__ {
		accdet = "/fragment@10:target:0";
		auxadc = "/fragment@31:target:0", "/fragment@32/__overlay__:io-channels:0";
		charger = "/fragment@22:target:0";
		chosen = "/fragment@0:target:0";
		consys = "/fragment@15:target:0";
		dsi0 = "/fragment@7:target:0";
		dsi_te = "/fragment@50:target:0";
		gpio = "/fragment@45:target:0";
		gpio_usage_mapping = "/fragment@44:target:0";
		i2c0 = "/fragment@34:target:0";
		i2c1 = "/fragment@35:target:0";
		i2c2 = "/fragment@36:target:0";
		i2c3 = "/fragment@37:target:0";
		i2c4 = "/fragment@28:target:0", "/fragment@38:target:0";
		i2c5 = "/fragment@39:target:0";
		i2c6 = "/fragment@27:target:0", "/fragment@40:target:0";
		i2c7 = "/fragment@41:target:0";
		i2c8 = "/fragment@29:target:0", "/fragment@42:target:0";
		i2c9 = "/fragment@43:target:0";
		kd_camera_hw1 = "/fragment@25:target:0", "/fragment@54:target:0";
		keypad = "/fragment@8:target:0", "/fragment@56:target:0";
		lk_charger = "/fragment@23:target:0";
		md1_sim1_hot_plug_eint = "/fragment@51:target:0";
		md_auxadc = "/fragment@32:target:0";
		mrdump_ext_rst = "/fragment@46:target:0";
		msdc1_ins = "/fragment@47:target:0";
		mt6360_chg = "/fragment@4:target:0";
		mt6360_pmic = "/fragment@2:target:0";
		mt6360_pmu = "/fragment@1:target:0";
		mt6360_typec = "/fragment@3:target:0";
		mt_pmic_vcamio_ldo_reg = "/fragment@25/__overlay__:cam0_vcamio-supply:0", "/fragment@25/__overlay__:cam1_vcamio-supply:0", "/fragment@52:target:0", "/fragment@54/__overlay__:vcamio-supply:0", "/fragment@54/__overlay__:vcamio_sub-supply:0";
		mt_pmic_vfp_ldo_reg = "/fragment@12/__overlay__/fingerprint@0:vmch-supply:0";
		mt_pmic_vtp_ldo_reg = "/fragment@53:target:0", "/fragment@55/__overlay__:vtouch-supply:0";
		mtkfb = "/fragment@6:target:0";
		odm = "/fragment@11:target:0", "/fragment@21:target:0";
		pio = "/fragment@1/__overlay__:mt6360,intr_gpio:0", "/fragment@1/__overlay__:mt6360,tc30_dp_gpio:0", "/fragment@1/__overlay__:mt6360,tc30_dm_gpio:0", "/fragment@3/__overlay__:mt6360pd,intr_gpio:0", "/fragment@5:target:0", "/fragment@7/__overlay__/panel1@0:reset-gpios:0", "/fragment@7/__overlay__/panel1@0:bias-gpios:0", "/fragment@7/__overlay__/panel1@0:bias-gpios:12", "/fragment@9:target:0", "/fragment@11/__overlay__/tran_audio:fs_extamp_gpio:0", "/fragment@11/__overlay__/fingerprint:interrupt-parent:0", "/fragment@12/__overlay__/fingerprint@0:interrupt-parent:0", "/fragment@12/__overlay__/fingerprint@0:irq-gpio-std:0", "/fragment@12/__overlay__/fingerprint@0:reset-gpio-std:0", "/fragment@13:target:0", "/fragment@14:target:0", "/fragment@16:target:0", "/fragment@16/__overlay__/fmradio:fm_lna_gpio:0", "/fragment@19:target:0", "/fragment@24:target:0", "/fragment@25/__overlay__:camera_input_gpio:0", "/fragment@26:target:0", "/fragment@30:target:0", "/fragment@44/__overlay__:GPIO_SIM1_HOT_PLUG:0", "/fragment@44/__overlay__:GPIO_SIM2_SCLK:0", "/fragment@44/__overlay__:GPIO_SIM2_SRST:0", "/fragment@44/__overlay__:GPIO_SIM2_SIO:0", "/fragment@44/__overlay__:GPIO_SIM1_SIO:0", "/fragment@44/__overlay__:GPIO_SIM1_SRST:0", "/fragment@44/__overlay__:GPIO_SIM1_SCLK:0", "/fragment@44/__overlay__:GPIO_RF_PWREN_RST_PIN:0", "/fragment@46/__overlay__:interrupt-parent:0", "/fragment@46/__overlay__:deb-gpios:0", "/fragment@47/__overlay__:interrupt-parent:0", "/fragment@47/__overlay__:deb-gpios:0", "/fragment@48/__overlay__:interrupt-parent:0", "/fragment@49/__overlay__:interrupt-parent:0", "/fragment@50/__overlay__:interrupt-parent:0";
		pmic_clock_buffer_ctrl = "/fragment@33:target:0";
		spi0 = "/fragment@12:target:0";
		spi1 = "/fragment@17:target:0";
		subpmic_pmu_eint = "/fragment@48:target:0";
		touch = "/fragment@18:target:0", "/fragment@49:target:0", "/fragment@55:target:0";
		u2port0 = "/fragment@20:target:0";
	};

	__local_fixups__ {

		fragment@11 {

			__overlay__ {

				cam_vdd_ext {
					pinctrl-0 = <0x0>;
					pinctrl-1 = <0x0>;
					pinctrl-2 = <0x0>;
				};

				fingerprint {
					pinctrl-0 = <0x0>;
					pinctrl-1 = <0x0>;
					pinctrl-2 = <0x0>;
					pinctrl-3 = <0x0>;
					pinctrl-4 = <0x0>;
				};

				flashlights_aw36515 {
					pinctrl-0 = <0x0>;
					pinctrl-1 = <0x0>;
					pinctrl-2 = <0x0>;
				};
			};
		};

		fragment@12 {

			__overlay__ {

				fingerprint@0 {
					pinctrl-0 = <0x0>;
					pinctrl-1 = <0x0>;
					pinctrl-2 = <0x0>;
					pinctrl-3 = <0x0>;
					pinctrl-4 = <0x0>;
				};
			};
		};

		fragment@15 {

			__overlay__ {
				pinctrl-0 = <0x0>;
				pinctrl-1 = <0x0>;
				pinctrl-2 = <0x0>;
				pinctrl-3 = <0x0>;
			};
		};

		fragment@18 {

			__overlay__ {
				pinctrl-0 = <0x0>;
				pinctrl-1 = <0x0>;
				pinctrl-2 = <0x0>;
				pinctrl-3 = <0x0>;
				pinctrl-4 = <0x0>;
				pinctrl-5 = <0x0>;
			};
		};

		fragment@25 {

			__overlay__ {
				pinctrl-0 = <0x0>;
				pinctrl-1 = <0x0>;
				pinctrl-10 = <0x0>;
				pinctrl-11 = <0x0>;
				pinctrl-12 = <0x0>;
				pinctrl-13 = <0x0>;
				pinctrl-14 = <0x0>;
				pinctrl-15 = <0x0>;
				pinctrl-16 = <0x0>;
				pinctrl-17 = <0x0>;
				pinctrl-18 = <0x0>;
				pinctrl-19 = <0x0>;
				pinctrl-2 = <0x0>;
				pinctrl-20 = <0x0>;
				pinctrl-21 = <0x0>;
				pinctrl-22 = <0x0>;
				pinctrl-23 = <0x0>;
				pinctrl-24 = <0x0>;
				pinctrl-25 = <0x0>;
				pinctrl-26 = <0x0>;
				pinctrl-27 = <0x0>;
				pinctrl-28 = <0x0>;
				pinctrl-29 = <0x0>;
				pinctrl-3 = <0x0>;
				pinctrl-4 = <0x0>;
				pinctrl-5 = <0x0>;
				pinctrl-6 = <0x0>;
				pinctrl-7 = <0x0>;
				pinctrl-8 = <0x0>;
				pinctrl-9 = <0x0>;
			};
		};

		fragment@6 {

			__overlay__ {
				pinctrl-0 = <0x0>;
				pinctrl-1 = <0x0>;
				pinctrl-2 = <0x0>;
				pinctrl-3 = <0x0>;
				pinctrl-4 = <0x0>;
				pinctrl-5 = <0x0>;
				pinctrl-6 = <0x0>;
			};
		};

		fragment@7 {

			__overlay__ {

				panel1@0 {

					port {

						endpoint {
							remote-endpoint = <0x0>;
						};
					};
				};

				ports {

					port {

						endpoint {
							remote-endpoint = <0x0>;
						};
					};
				};
			};
		};

		fragment@8 {

			__overlay__ {
				pinctrl-0 = <0x0>;
			};
		};
	};

	__symbols__ {
		cam_vdd_ext = "/fragment@11/__overlay__/cam_vdd_ext";
		camera_main_af_mtk = "/fragment@38/__overlay__/camera_main_af@0c";
		camera_main_eeprom_mtk = "/fragment@38/__overlay__/camera_main_eeprom@50";
		camera_main_mtk = "/fragment@38/__overlay__/camera_main@1a";
		camera_main_two_mtk = "/fragment@43/__overlay__/camera_main_two@10";
		camera_pins_cam0_mclk_2ma = "/fragment@24/__overlay__/camera_pins_cam0_mclk_2ma";
		camera_pins_cam0_mclk_4ma = "/fragment@24/__overlay__/camera_pins_cam0_mclk_4ma";
		camera_pins_cam0_mclk_6ma = "/fragment@24/__overlay__/camera_pins_cam0_mclk_6ma";
		camera_pins_cam0_mclk_8ma = "/fragment@24/__overlay__/camera_pins_cam0_mclk_8ma";
		camera_pins_cam0_mclk_off = "/fragment@24/__overlay__/camera_pins_cam0_mclk_off";
		camera_pins_cam0_pdn_0 = "/fragment@24/__overlay__/cam0@2";
		camera_pins_cam0_pdn_1 = "/fragment@24/__overlay__/cam0@3";
		camera_pins_cam0_rst_0 = "/fragment@24/__overlay__/cam0@0";
		camera_pins_cam0_rst_1 = "/fragment@24/__overlay__/cam0@1";
		camera_pins_cam0_vs2pmu_0 = "/fragment@24/__overlay__/cam0@vcam2";
		camera_pins_cam0_vs2pmu_1 = "/fragment@24/__overlay__/cam0@vcam3";
		camera_pins_cam1_mclk_2ma = "/fragment@24/__overlay__/camera_pins_cam1_mclk_2ma";
		camera_pins_cam1_mclk_4ma = "/fragment@24/__overlay__/camera_pins_cam1_mclk_4ma";
		camera_pins_cam1_mclk_6ma = "/fragment@24/__overlay__/camera_pins_cam1_mclk_6ma";
		camera_pins_cam1_mclk_8ma = "/fragment@24/__overlay__/camera_pins_cam1_mclk_8ma";
		camera_pins_cam1_mclk_off = "/fragment@24/__overlay__/camera_pins_cam1_mclk_off";
		camera_pins_cam1_pdn_0 = "/fragment@24/__overlay__/cam1@2";
		camera_pins_cam1_pdn_1 = "/fragment@24/__overlay__/cam1@3";
		camera_pins_cam1_rst_0 = "/fragment@24/__overlay__/cam1@0";
		camera_pins_cam1_rst_1 = "/fragment@24/__overlay__/cam1@1";
		camera_pins_cam2_mclk_2ma = "/fragment@24/__overlay__/camera_pins_cam2_mclk_2ma";
		camera_pins_cam2_mclk_4ma = "/fragment@24/__overlay__/camera_pins_cam2_mclk_4ma";
		camera_pins_cam2_mclk_6ma = "/fragment@24/__overlay__/camera_pins_cam2_mclk_6ma";
		camera_pins_cam2_mclk_8ma = "/fragment@24/__overlay__/camera_pins_cam2_mclk_8ma";
		camera_pins_cam2_mclk_off = "/fragment@24/__overlay__/camera_pins_cam2_mclk_off";
		camera_pins_cam2_pdn_0 = "/fragment@24/__overlay__/cam2@0";
		camera_pins_cam2_pdn_1 = "/fragment@24/__overlay__/cam2@1";
		camera_pins_default = "/fragment@24/__overlay__/camdefault";
		camera_sub_eeprom_mtk = "/fragment@42/__overlay__/camera_sub_eeprom@50";
		camera_sub_mtk = "/fragment@42/__overlay__/camera_sub@1a";
		consys_pins_default = "/fragment@14/__overlay__/consys_default";
		ctp_pins_default = "/fragment@19/__overlay__/eint0default";
		ctp_pins_eint_as_int = "/fragment@19/__overlay__/ctp_eint@0";
		ctp_pins_eint_output0 = "/fragment@19/__overlay__/ctp_eintoutput0";
		ctp_pins_eint_output1 = "/fragment@19/__overlay__/ctp_eintoutput1";
		ctp_pins_rst_output0 = "/fragment@19/__overlay__/rstoutput0";
		ctp_pins_rst_output1 = "/fragment@19/__overlay__/rstoutput1";
		dsi_out = "/fragment@7/__overlay__/ports/port/endpoint";
		ext_ldo_pins_default = "/fragment@26/__overlay__/extldodefault";
		ext_ldo_pins_hwen_high = "/fragment@26/__overlay__/extldo_en_high";
		ext_ldo_pins_hwen_low = "/fragment@26/__overlay__/extldo_en_low";
		fingerprint = "/fragment@11/__overlay__/fingerprint";
		fingerprint_default = "/fragment@13/__overlay__/fingerprint_default";
		fingerprint_eint = "/fragment@13/__overlay__/gpio22_eint";
		fingerprint_eint_pull_down = "/fragment@13/__overlay__/gpio22_eint_pull_down";
		fingerprint_rst_one = "/fragment@13/__overlay__/rst_out_one";
		fingerprint_rst_zero = "/fragment@13/__overlay__/rst_out_zero";
		flashlights_aw36515 = "/fragment@11/__overlay__/flashlights_aw36515";
		flashlights_aw36515_pins_default = "/fragment@30/__overlay__/aw36515default";
		flashlights_aw36515_pins_hwen_high = "/fragment@30/__overlay__/aw36515hwen_high";
		flashlights_aw36515_pins_hwen_low = "/fragment@30/__overlay__/aw36515hwen_low";
		fmradio = "/fragment@16/__overlay__/fmradio";
		gpslna_pins_init = "/fragment@14/__overlay__/gpslna@0";
		gpslna_pins_oh = "/fragment@14/__overlay__/gpslna@1";
		gpslna_pins_ol = "/fragment@14/__overlay__/gpslna@2";
		i2c_lcd_bias_mtk = "/fragment@40/__overlay__/i2c_lcd_bias@3e";
		kpd_pins_default = "/fragment@9/__overlay__/kpdgpiodefault";
		led0 = "/fragment@11/__overlay__/led@0";
		led1 = "/fragment@11/__overlay__/led@1";
		led2 = "/fragment@11/__overlay__/led@2";
		led3 = "/fragment@11/__overlay__/led@3";
		led4 = "/fragment@11/__overlay__/led@4";
		led5 = "/fragment@11/__overlay__/led@5";
		led6 = "/fragment@11/__overlay__/led@6";
		mtk_camera_eeprom0 = "/fragment@28/__overlay__/camera_eeprom0@50";
		mtk_camera_eeprom1 = "/fragment@29/__overlay__/camera_eeprom1@51";
		mtkfb_pins_default = "/fragment@5/__overlay__/dispdefault";
		mtkfb_pins_lcd_bias_enn0 = "/fragment@5/__overlay__/lcd_bias_enn0_gpio";
		mtkfb_pins_lcd_bias_enn1 = "/fragment@5/__overlay__/lcd_bias_enn1_gpio";
		mtkfb_pins_lcd_bias_enp0 = "/fragment@5/__overlay__/lcd_bias_enp0_gpio";
		mtkfb_pins_lcd_bias_enp1 = "/fragment@5/__overlay__/lcd_bias_enp1_gpio";
		mtkfb_pins_lcm_reset0 = "/fragment@5/__overlay__/lcm_rst_out0_gpio";
		mtkfb_pins_lcm_reset1 = "/fragment@5/__overlay__/lcm_rst_out1_gpio";
		nfc_mtk = "/fragment@37/__overlay__/nfc@08";
		panel_in1 = "/fragment@7/__overlay__/panel1@0/port/endpoint";
		strobe_main_mtk = "/fragment@40/__overlay__/strobe_main@63";
		subpmic_ldo_mtk = "/fragment@39/__overlay__/subpmic_ldo@64";
		subpmic_mtk = "/fragment@39/__overlay__/subpmic@34";
		subpmic_pmic_mtk = "/fragment@39/__overlay__/subpmic_pmic@1a";
		tran_audio = "/fragment@11/__overlay__/tran_audio";
		tran_battery = "/fragment@21/__overlay__/tran_battery";
		tran_battery_aging = "/fragment@21/__overlay__/tran_battery_aging";
		tran_touch = "/fragment@17/__overlay__/touch";
		usb_type_c_mtk = "/fragment@39/__overlay__/usb_type_c@4e";
		vibrator0 = "/fragment@11/__overlay__/vibrator@0";
	};

	fragment@0 {
		target = <0xffffffff>;

		__overlay__ {
			atag,videolfb-fb_base_h = <0x0>;
			atag,videolfb-fb_base_l = "~`P";
			atag,videolfb-fps = <0x1770>;
			atag,videolfb-islcm_inited = <0x0>;
			atag,videolfb-islcmfound = <0x1>;
			atag,videolfb-lcmname = "nt35595_fhd_dsi_cmd_truly_nt50358_drv";
			atag,videolfb-vramSize = <0x1be0000>;
		};
	};

	fragment@1 {
		target = <0xffffffff>;

		__overlay__ {
			mt6360,intr_gpio = <0xffffffff 0xa 0x0>;
			mt6360,intr_gpio_num = <0xa>;
			mt6360,tc30_dm_gpio = <0xffffffff 0x83 0x0>;
			mt6360,tc30_dp_gpio = <0xffffffff 0x8c 0x0>;
		};
	};

	fragment@10 {
		target = <0xffffffff>;

		__overlay__ {
			accdet-mic-mode = <0x2>;
			accdet-mic-vol = <0x8>;
			accdet-plugout-debounce = <0x1>;
			eint_use_ext_res = <0x0>;
			headset-four-key-threshold = <0x0 0x3a 0x79 0xc0 0x190>;
			headset-mode-setting = <0x500 0x500 0x1 0x1f0 0x800 0x800 0x20 0x44 0x4 0x1 0x5 0x3 0x3 0x5 0xe>;
			headset-three-key-threshold = <0x0 0x50 0xdc 0x190>;
			headset-three-key-threshold-CDD = <0x0 0x79 0xc0 0x258>;
			status = "okay";
		};
	};

	fragment@11 {
		target = <0xffffffff>;

		__overlay__ {

			cam_vdd_ext {
				compatible = "mediatek,cam_vdd_ext";
				phandle = <0x3d>;
				pinctrl-0 = <0xe>;
				pinctrl-1 = <0xf>;
				pinctrl-2 = <0x10>;
				pinctrl-names = "extldodefault", "extldo_en_high", "extldo_en_low";
				status = "okay";
			};

			fingerprint {
				compatible = "tran_fp";
				debounce = <0x16 0x0>;
				interrupt-parent = <0xffffffff>;
				interrupts = <0x16 0x1 0x16 0x0>;
				phandle = <0x47>;
				pinctrl-0 = <0x11>;
				pinctrl-1 = <0x12>;
				pinctrl-2 = <0x13>;
				pinctrl-3 = <0x14>;
				pinctrl-4 = <0x15>;
				pinctrl-names = "tran_fp_default", "tran_fp_pin_irq", "tran_fp_irq_pull_down", "tran_fp_reset_high", "tran_fp_reset_low";
				status = "okay";
			};

			flashlights_aw36515 {
				compatible = "mediatek,flashlights_aw36515";
				phandle = <0x3c>;
				pinctrl-0 = <0xb>;
				pinctrl-1 = <0xc>;
				pinctrl-2 = <0xd>;
				pinctrl-names = "aw36515default", "aw36515hwen_high", "aw36515hwen_low";
				status = "okay";
			};

			led@0 {
				compatible = "mediatek,red";
				data = <0x1>;
				led_mode = <0x0>;
				phandle = <0x3e>;
				pwm_config = <0x0 0x0 0x0 0x0 0x0>;
			};

			led@1 {
				compatible = "mediatek,green";
				data = <0x1>;
				led_mode = <0x0>;
				phandle = <0x3f>;
				pwm_config = <0x0 0x0 0x0 0x0 0x0>;
			};

			led@2 {
				compatible = "mediatek,blue";
				data = <0x1>;
				led_mode = <0x0>;
				phandle = <0x40>;
				pwm_config = <0x0 0x0 0x0 0x0 0x0>;
			};

			led@3 {
				compatible = "mediatek,jogball-backlight";
				data = <0x1>;
				led_mode = <0x0>;
				phandle = <0x41>;
				pwm_config = <0x0 0x0 0x0 0x0 0x0>;
			};

			led@4 {
				compatible = "mediatek,keyboard-backlight";
				data = <0x1>;
				led_mode = <0x0>;
				phandle = <0x42>;
				pwm_config = <0x0 0x0 0x0 0x0 0x0>;
			};

			led@5 {
				compatible = "mediatek,button-backlight";
				data = <0x1>;
				led_mode = <0x0>;
				phandle = <0x43>;
				pwm_config = <0x0 0x0 0x0 0x0 0x0>;
			};

			led@6 {
				compatible = "mediatek,lcd-backlight";
				data = <0x1>;
				led_mode = <0x5>;
				phandle = <0x44>;
				pwm_config = <0x1 0x0 0x0 0x0 0x0>;
			};

			tran_audio {
				compatible = "tran_audio,audio";
				fs_extamp_gpio = <0xffffffff 0x8b 0x0>;
				fs_extamp_mode = <0x6>;
				fs_extamp_speech_mode = <0x5>;
				fs_receiver_mode = <0x2>;
				phandle = <0x46>;
			};

			vibrator@0 {
				compatible = "mediatek,vibrator";
				phandle = <0x45>;
				vib_limit = <0x9>;
				vib_timer = <0x19>;
				vib_vol = <0xb>;
			};
		};
	};

	fragment@12 {
		target = <0xffffffff>;

		__overlay__ {

			fingerprint@0 {
				compatible = "tran_fp";
				debounce = <0x16 0x0>;
				interrupt-parent = <0xffffffff>;
				interrupts = <0x16 0x1 0x16 0x0>;
				irq-gpio = <0x16>;
				irq-gpio-std = <0xffffffff 0x16 0x0>;
				pinctrl-0 = <0x11>;
				pinctrl-1 = <0x12>;
				pinctrl-2 = <0x13>;
				pinctrl-3 = <0x14>;
				pinctrl-4 = <0x15>;
				pinctrl-names = "tran_fp_default", "tran_fp_pin_irq", "tran_fp_irq_pull_down", "tran_fp_reset_high", "tran_fp_reset_low";
				reg = <0x0>;
				reset-gpio = <0x15>;
				reset-gpio-std = <0xffffffff 0x15 0x0>;
				spi-max-frequency = <0x19bfcc0>;
				status = "okay";
				vmch-supply = <0xffffffff>;
			};
		};
	};

	fragment@13 {
		target = <0xffffffff>;

		__overlay__ {

			fingerprint_default {
				phandle = <0x11>;
			};

			gpio22_eint {
				phandle = <0x12>;

				pins_cmd_dat {
					bias-disable;
					pinmux = <0x1600>;
					slew-rate = <0x0>;
				};
			};

			gpio22_eint_pull_down {
				phandle = <0x13>;

				pins_cmd_dat {
					bias-pull-down = <0x0>;
					output-low;
					pinmux = <0x1600>;
					slew-rate = <0x0>;
				};
			};

			rst_out_one {
				phandle = <0x14>;

				pins_cmd_dat {
					bias-disable;
					output-high;
					pinmux = <0x1500>;
					slew-rate = <0x1>;
				};
			};

			rst_out_zero {
				phandle = <0x15>;

				pins_cmd_dat {
					bias-disable;
					output-low;
					pinmux = <0x1500>;
					slew-rate = <0x1>;
				};
			};
		};
	};

	fragment@14 {
		target = <0xffffffff>;

		__overlay__ {

			consys_default {
				phandle = <0x16>;
			};

			gpslna@0 {
				phandle = <0x17>;

				pins_cmd_dat {
					bias-disable;
					output-low;
					pinmux = <0x5700>;
					slew-rate = <0x0>;
				};
			};

			gpslna@1 {
				phandle = <0x18>;

				pins_cmd_dat {
					output-high;
					pinmux = <0x5700>;
					slew-rate = <0x1>;
				};
			};

			gpslna@2 {
				phandle = <0x19>;

				pins_cmd_dat {
					output-low;
					pinmux = <0x5700>;
					slew-rate = <0x1>;
				};
			};
		};
	};

	fragment@15 {
		target = <0xffffffff>;

		__overlay__ {
			pinctrl-0 = <0x16>;
			pinctrl-1 = <0x17>;
			pinctrl-2 = <0x18>;
			pinctrl-3 = <0x19>;
			pinctrl-names = "default", "gps_lna_state_init", "gps_lna_state_oh", "gps_lna_state_ol", "fm_gpio_func_1", "fm_gpio_func_0";
			status = "okay";
		};
	};

	fragment@16 {
		target = <0xffffffff>;

		__overlay__ {

			fmradio {
				#address-cells = <0x2>;
				#size-cells = <0x2>;
				compatible = "mediatek,fmradio";
				fm_lna_gpio = <0xffffffff 0x13 0x0>;
				phandle = <0x48>;
				status = "okay";
			};
		};
	};

	fragment@17 {
		target = <0xffffffff>;

		__overlay__ {

			touch {
				chipone,compensate-cap-max = <0x7e>;
				chipone,compensate-cap-min = <0x1>;
				chipone,noise-max = <0x7d>;
				chipone,open-min = <0x6a4>;
				chipone,rawdata-max = <0xb49>;
				chipone,rawdata-min = <0x4b9>;
				chipone,short-min = <0x6a4>;
				chipone,test-compensate-cap;
				chipone,test-noise;
				chipone,test-noise-frames = <0x32>;
				chipone,test-open;
				chipone,test-rawdata;
				chipone,test-rawdata-frames = <0x1>;
				chipone,test-reset-pin;
				chipone,test-short;
				chipone,touch-charger-detect-enable;
				chipone,touch-charger-detect-psp = "POWER_SUPPLY_PROP_STATUS";
				chipone,touch-charger-detect-psp-poll-interval = <0x3e8>;
				chipone,touch-charger-detect-psy-name = "battery";
				chipone,touch-charger-detect-type = "notify";
				compatible = "mediatek,chipone_touch", "mediatek,cap_touch_2";
				omnivision,block-delay-us = <0x10>;
				omnivision,byte-delay-us = <0x10>;
				omnivision,irq-on-state = <0x0>;
				omnivision,power-delay-ms = <0xc8>;
				omnivision,reset-active-ms = <0x14>;
				omnivision,reset-delay-ms = <0xc8>;
				omnivision,reset-on-state = <0x0>;
				omnivision,spi-mode = <0x3>;
				omnivision,ubl-byte-delay-us = <0x14>;
				omnivision,ubl-max-freq = <0x3e8000>;
				phandle = <0x49>;
				reg = <0x0>;
				spi-max-frequency = <0x3e8000>;
				status = "okay";
			};
		};
	};

	fragment@18 {
		target = <0xffffffff>;

		__overlay__ {
			pinctrl-0 = <0x1a>;
			pinctrl-1 = <0x1b>;
			pinctrl-2 = <0x1c>;
			pinctrl-3 = <0x1d>;
			pinctrl-4 = <0x1e>;
			pinctrl-5 = <0x1f>;
			pinctrl-names = "default", "state_eint_as_int", "state_eint_output0", "state_eint_output1", "state_rst_output0", "state_rst_output1";
			status = "okay";
			tpd-filter-custom-prameters = <0x0 0x0 0x0 0x0 0x0 0x0 0x0 0x0 0x0 0x0 0x0 0x0>;
			tpd-filter-custom-speed = <0x0 0x0 0x0>;
			tpd-filter-enable = <0x0>;
			tpd-filter-pixel-density = <0x6a>;
			tpd-key-dim-local = <0x5a 0x373 0x64 0x28 0xe6 0x373 0x64 0x28 0x172 0x373 0x64 0x28 0x0 0x0 0x0 0x0>;
			tpd-key-local = <0x8b 0xac 0x9e 0x0>;
			tpd-key-num = <0x3>;
			tpd-max-touch-num = <0x5>;
			tpd-resolution = <0x2d0 0x64c>;
			use-tpd-button = <0x0>;
		};
	};

	fragment@19 {
		target = <0xffffffff>;

		__overlay__ {

			ctp_eint@0 {
				phandle = <0x1b>;

				pins_cmd_dat {
					pinmux = <0xe00>;
					slew-rate = <0x0>;
				};
			};

			ctp_eintoutput0 {
				phandle = <0x1c>;

				pins_cmd_dat {
					output-low;
					pinmux = <0xe00>;
					slew-rate = <0x1>;
				};
			};

			ctp_eintoutput1 {
				phandle = <0x1d>;

				pins_cmd_dat {
					output-high;
					pinmux = <0xe00>;
					slew-rate = <0x1>;
				};
			};

			eint0default {
				phandle = <0x1a>;
			};

			rstoutput0 {
				phandle = <0x1e>;

				pins_cmd_dat {
					output-low;
					pinmux = <0xf00>;
					slew-rate = <0x1>;
				};
			};

			rstoutput1 {
				phandle = <0x1f>;

				pins_cmd_dat {
					output-high;
					pinmux = <0xf00>;
					slew-rate = <0x1>;
				};
			};
		};
	};

	fragment@2 {
		target = <0xffffffff>;

		__overlay__ {
			pwr_off_seq = <0x4000002>;
		};
	};

	fragment@20 {
		target = <0xffffffff>;

		__overlay__ {
			mediatek,eye-rev6 = <0x1>;
			mediatek,eye-term = <0x5>;
			mediatek,eye-vrt = <0x7>;
			mediatek,host-eye-rev6 = <0x1>;
			mediatek,host-eye-term = <0x5>;
			mediatek,host-eye-vrt = <0x7>;
		};
	};

	fragment@21 {
		target = <0xffffffff>;

		__overlay__ {

			tran_battery {
				compatible = "tran,chg_fun";
				enable_pcb_tml;
				jeita_above_t4_chg_cur = <0x0>;
				jeita_above_t4_input_cur = <0xf4240>;
				jeita_below_t0_chg_cur = <0x0>;
				jeita_below_t0_input_cur = <0x16e360>;
				jeita_t0_to_t1_chg_cur = <0xf4240>;
				jeita_t0_to_t1_input_cur = <0x16e360>;
				jeita_t2_to_t3_chg_cur = <0x1e8480>;
				jeita_t2_to_t3_input_cur = <0x200b20>;
				jeita_t3_to_t4_chg_cur = <0x1e8480>;
				jeita_t3_to_t4_input_cur = <0x200b20>;
				pcb_cur_step_one = <0xc8>;
				pcb_cur_step_two = <0x1f4>;
				pcb_min_chg_cur = <0xf4240>;
				pcb_temp_step_one = <0xa410>;
				pcb_temp_step_two = <0xabe0>;
				phandle = <0x4a>;
			};

			tran_battery_aging {
				battery_aging_module0 = <0x0>;
				battery_aging_module1 = <0x0>;
				battery_aging_module2 = <0x0>;
				battery_aging_module3 = <0x0>;
				compatible = "tran,chg_aging";
				phandle = <0x4b>;
			};
		};
	};

	fragment@22 {
		target = <0xffffffff>;

		__overlay__ {
			ac_charger_current = <0x1e8480>;
			ac_charger_input_current = <0x1e8480>;
			algorithm_name = "SwitchCharging";
			apple_1_0a_charger_current = <0x9eb10>;
			apple_2_1a_charger_current = <0xc3500>;
			battery_cv = <0x432380 0x432380 0x432380 0x432380>;
			bif_cv_under_threshold2 = <0x43e6d0>;
			bif_threshold1 = <0x40d990>;
			bif_threshold2 = <0x419ce0>;
			cable_imp_threshold = <0x2bb>;
			charging_host_charger_current = <0x16e360>;
			chg1_ta_ac_charger_current = <0x16e360>;
			chg2_ta_ac_charger_current = <0x16e360>;
			compatible = "mediatek,charger";
			disable_pd_dual;
			dual_polling_ieoc = <0x6ddd0>;
			enable_dynamic_mivr;
			enable_hvdcp20;
			enable_ir_comp;
			enable_min_charge_temp;
			enable_pe_2;
			enable_pe_plus;
			enable_sw_jeita;
			enable_tc30;
			high_temp_to_enter_pe40 = <0x27>;
			high_temp_to_leave_pe40 = <0x2e>;
			ibus_err = <0xe>;
			jeita_temp_above_t4_cv = <0x3e8fa0 0x3e8fa0 0x3e8fa0 0x3e8fa0>;
			jeita_temp_below_t0_cv = <0x432380 0x432380 0x432380 0x432380>;
			jeita_temp_t0_to_t1_cv = <0x432380 0x432380 0x432380 0x432380>;
			jeita_temp_t1_to_t2_cv = <0x432380 0x432380 0x432380 0x432380>;
			jeita_temp_t2_to_t3_cv = <0x432380 0x432380 0x432380 0x432380>;
			jeita_temp_t3_to_t4_cv = <0x3e8fa0 0x3e8fa0 0x3e8fa0 0x3e8fa0>;
			low_temp_to_enter_pe40 = <0x10>;
			low_temp_to_leave_pe40 = <0xa>;
			max_charge_temp = <0x35>;
			max_charge_temp_minus_x_degree = <0x34>;
			max_charger_voltage = <0x632ea0>;
			max_charging_time = <0x11940>;
			max_dmivr_charger_current = <0x155cc0>;
			min_charge_temp = <0x0>;
			min_charge_temp_plus_x_degree = <0x1>;
			min_charger_voltage = <0x4630c0>;
			min_charger_voltage_1 = <0x4630c0>;
			min_charger_voltage_2 = <0x432380>;
			multi_battery_cv;
			non_std_ac_charger_current = <0x124f80>;
			pd_ichg_level_threshold = <0xf4240>;
			pd_stop_battery_soc = <0x50>;
			pd_vbus_low_bound = <0x4c4b40>;
			pd_vbus_upper_bound = <0x989680>;
			pe20_ichg_level_threshold = <0xf4240>;
			pe40_dual_charger_chg1_current = <0x1e8480>;
			pe40_dual_charger_chg2_current = <0x1e8480>;
			pe40_dual_charger_input_current = <0x2dc6c0>;
			pe40_r_cable_1a_lower = <0x206>;
			pe40_r_cable_2a_lower = <0x17f>;
			pe40_r_cable_3a_lower = <0xf5>;
			pe40_single_charger_current = <0x2dc6c0>;
			pe40_single_charger_input_current = <0x2dc6c0>;
			pe40_stop_battery_soc = <0x50>;
			pe_ichg_level_threshold = <0xf4240>;
			power_path_support;
			r_bat_comp = <0x14>;
			slave_mivr_diff = <0x186a0>;
			ta_9v_support;
			ta_ac_12v_input_current = <0x30d400>;
			ta_ac_7v_input_current = <0x249f00>;
			ta_ac_9v_input_current = <0x200b20>;
			ta_ac_charger_current = <0x36ee80>;
			ta_start_battery_soc = <0x0>;
			ta_stop_battery_soc = <0x5a>;
			temp_neg_10_thres = <0x2>;
			temp_t0_thres = <0x1>;
			temp_t0_thres_plus_x_degree = <0x1>;
			temp_t1_thres = <0x1>;
			temp_t1_thres_plus_x_degree = <0x1>;
			temp_t2_thres = <0xf>;
			temp_t2_thres_plus_x_degree = <0x10>;
			temp_t3_thres = <0x2d>;
			temp_t3_thres_minus_x_degree = <0x2c>;
			temp_t4_thres = <0x37>;
			temp_t4_thres_minus_x_degree = <0x33>;
			usb_charger_current = <0x7a120>;
			usb_charger_current_configured = <0x7a120>;
			usb_charger_current_suspend = <0x0>;
			usb_charger_current_unconfigured = <0x11170>;
			v_comp_max = <0x1388>;
			vbat_cable_imp_threshold = <0x3b8260>;
			vsys_watt = <0x4c4b40>;
		};
	};

	fragment@23 {
		target = <0xffffffff>;

		__overlay__ {
			ac_charger_current = <0x16e360>;
			ac_charger_input_current = <0x16e360>;
			charging_host_charger_current = <0x16e360>;
			compatible = "mediatek,lk_charger";
			cur_threshold = <0x7a120>;
			enable_anime;
			enable_pd20_reset;
			enable_pe_plus;
			fast_charge_voltage = <0x2625a0>;
			max_charger_voltage = <0x632ea0>;
			non_std_ac_charger_current = <0x7a120>;
			pd_charger_current = <0x7a120>;
			power_path_support;
			ta_ac_charger_current = <0x2dc6c0>;
			temp_t1_threshold = <0x0>;
			temp_t2_threshold = <0xf>;
			temp_t3_threshold = <0x2d>;
			temp_t4_threshold = <0x32>;
			usb_charger_current = <0x7a120>;
		};
	};

	fragment@24 {
		target = <0xffffffff>;

		__overlay__ {

			cam0@0 {
				phandle = <0x21>;

				pins_cmd_dat {
					output-low;
					pinmux = <0x3800>;
					slew-rate = <0x1>;
				};
			};

			cam0@1 {
				phandle = <0x22>;

				pins_cmd_dat {
					output-high;
					pinmux = <0x3800>;
					slew-rate = <0x1>;
				};
			};

			cam0@2 {
				phandle = <0x23>;

				pins_cmd_dat {
					output-low;
					pinmux = <0x3700>;
					slew-rate = <0x1>;
				};
			};

			cam0@3 {
				phandle = <0x24>;

				pins_cmd_dat {
					output-high;
					pinmux = <0x3700>;
					slew-rate = <0x1>;
				};
			};

			cam0@vcam2 {
				phandle = <0x3a>;

				pins_cmd_dat {
					output-low;
					pinmux = <0x2d00>;
					slew-rate = <0x1>;
				};
			};

			cam0@vcam3 {
				phandle = <0x3b>;

				pins_cmd_dat {
					output-high;
					pinmux = <0x2d00>;
					slew-rate = <0x1>;
				};
			};

			cam1@0 {
				phandle = <0x25>;

				pins_cmd_dat {
					output-low;
					pinmux = <0x3600>;
					slew-rate = <0x1>;
				};
			};

			cam1@1 {
				phandle = <0x26>;

				pins_cmd_dat {
					output-high;
					pinmux = <0x3600>;
					slew-rate = <0x1>;
				};
			};

			cam1@2 {
				phandle = <0x27>;

				pins_cmd_dat {
					output-low;
					pinmux = <0x3500>;
					slew-rate = <0x1>;
				};
			};

			cam1@3 {
				phandle = <0x28>;

				pins_cmd_dat {
					output-high;
					pinmux = <0x3500>;
					slew-rate = <0x1>;
				};
			};

			cam2@0 {
				phandle = <0x29>;

				pins_cmd_dat {
					output-low;
					pinmux = <0x3b00>;
					slew-rate = <0x1>;
				};
			};

			cam2@1 {
				phandle = <0x2a>;

				pins_cmd_dat {
					output-high;
					pinmux = <0x3b00>;
					slew-rate = <0x1>;
				};
			};

			camdefault {
				phandle = <0x20>;
			};

			camera_pins_cam0_mclk_2ma {
				phandle = <0x2c>;

				pins_cmd_dat {
					drive-strength = <0x0>;
					pinmux = <0x3201>;
				};
			};

			camera_pins_cam0_mclk_4ma {
				phandle = <0x2d>;

				pins_cmd_dat {
					drive-strength = <0x1>;
					pinmux = <0x3201>;
				};
			};

			camera_pins_cam0_mclk_6ma {
				phandle = <0x2e>;

				pins_cmd_dat {
					drive-strength = <0x2>;
					pinmux = <0x3201>;
				};
			};

			camera_pins_cam0_mclk_8ma {
				phandle = <0x2f>;

				pins_cmd_dat {
					drive-strength = <0x3>;
					pinmux = <0x3201>;
				};
			};

			camera_pins_cam0_mclk_off {
				phandle = <0x2b>;

				pins_cmd_dat {
					drive-strength = <0x1>;
					pinmux = <0x3200>;
				};
			};

			camera_pins_cam1_mclk_2ma {
				phandle = <0x31>;

				pins_cmd_dat {
					drive-strength = <0x0>;
					pinmux = <0x3101>;
				};
			};

			camera_pins_cam1_mclk_4ma {
				phandle = <0x32>;

				pins_cmd_dat {
					drive-strength = <0x1>;
					pinmux = <0x3101>;
				};
			};

			camera_pins_cam1_mclk_6ma {
				phandle = <0x33>;

				pins_cmd_dat {
					drive-strength = <0x2>;
					pinmux = <0x3101>;
				};
			};

			camera_pins_cam1_mclk_8ma {
				phandle = <0x34>;

				pins_cmd_dat {
					drive-strength = <0x3>;
					pinmux = <0x3101>;
				};
			};

			camera_pins_cam1_mclk_off {
				phandle = <0x30>;

				pins_cmd_dat {
					drive-strength = <0x1>;
					pinmux = <0x3100>;
				};
			};

			camera_pins_cam2_mclk_2ma {
				phandle = <0x36>;

				pins_cmd_dat {
					drive-strength = <0x0>;
					pinmux = <0x3401>;
				};
			};

			camera_pins_cam2_mclk_4ma {
				phandle = <0x37>;

				pins_cmd_dat {
					drive-strength = <0x1>;
					pinmux = <0x3401>;
				};
			};

			camera_pins_cam2_mclk_6ma {
				phandle = <0x38>;

				pins_cmd_dat {
					drive-strength = <0x2>;
					pinmux = <0x3401>;
				};
			};

			camera_pins_cam2_mclk_8ma {
				phandle = <0x39>;

				pins_cmd_dat {
					drive-strength = <0x3>;
					pinmux = <0x3401>;
				};
			};

			camera_pins_cam2_mclk_off {
				phandle = <0x35>;

				pins_cmd_dat {
					drive-strength = <0x1>;
					pinmux = <0x3400>;
				};
			};
		};
	};

	fragment@25 {
		target = <0xffffffff>;

		__overlay__ {
			cam0_enable_sensor = "hi5021q_mipi_raw";
			cam0_vcamio-supply = <0xffffffff>;
			cam1_enable_sensor = "s5k4h7_mipi_raw";
			cam1_vcamio-supply = <0xffffffff>;
			cam2_enable_sensor = "fake_serial_yuv";
			camera_input_gpio = <0xffffffff 0x11 0x0>;
			pinctrl-0 = <0x20>;
			pinctrl-1 = <0x21>;
			pinctrl-10 = <0x2a>;
			pinctrl-11 = <0x2b>;
			pinctrl-12 = <0x2c>;
			pinctrl-13 = <0x2d>;
			pinctrl-14 = <0x2e>;
			pinctrl-15 = <0x2f>;
			pinctrl-16 = <0x30>;
			pinctrl-17 = <0x31>;
			pinctrl-18 = <0x32>;
			pinctrl-19 = <0x33>;
			pinctrl-2 = <0x22>;
			pinctrl-20 = <0x34>;
			pinctrl-21 = <0x35>;
			pinctrl-22 = <0x36>;
			pinctrl-23 = <0x37>;
			pinctrl-24 = <0x38>;
			pinctrl-25 = <0x39>;
			pinctrl-26 = <0x3a>;
			pinctrl-27 = <0x3b>;
			pinctrl-28 = <0x3a>;
			pinctrl-29 = <0x3b>;
			pinctrl-3 = <0x23>;
			pinctrl-4 = <0x24>;
			pinctrl-5 = <0x25>;
			pinctrl-6 = <0x26>;
			pinctrl-7 = <0x27>;
			pinctrl-8 = <0x28>;
			pinctrl-9 = <0x29>;
			pinctrl-names = "default", "cam0_rst0", "cam0_rst1", "cam0_pnd0", "cam0_pnd1", "cam1_rst0", "cam1_rst1", "cam1_pnd0", "cam1_pnd1", "cam2_pnd0", "cam2_pnd1", "cam0_mclk_off", "cam0_mclk_2mA", "cam0_mclk_4mA", "cam0_mclk_6mA", "cam0_mclk_8mA", "cam1_mclk_off", "cam1_mclk_2mA", "cam1_mclk_4mA", "cam1_mclk_6mA", "cam1_mclk_8mA", "cam2_mclk_off", "cam2_mclk_2mA", "cam2_mclk_4mA", "cam2_mclk_6mA", "cam2_mclk_8mA", "cam0_ldo_vs2pmu_0", "cam0_ldo_vs2pmu_1", "cam1_ldo_vs2pmu_0", "cam1_ldo_vs2pmu_1";
			status = "okay";
		};
	};

	fragment@26 {
		target = <0xffffffff>;

		__overlay__ {

			extldo_en_high {
				phandle = <0xf>;

				pins_cmd_dat {
					output-high;
					pinmux = <0x1400>;
				};
			};

			extldo_en_low {
				phandle = <0x10>;

				pins_cmd_dat {
					output-low;
					pinmux = <0x1400>;
				};
			};

			extldodefault {
				phandle = <0xe>;
			};
		};
	};

	fragment@27 {
		target = <0xffffffff>;

		__overlay__ {
			#address-cells = <0x1>;
			#size-cells = <0x0>;
			clock-frequency = <0x61a80>;
			mediatek,use-open-drain;

			cam_vdd_ext@28 {
				compatible = "mediatek,cam_vdd_ext";
				reg = <0x28>;
				status = "okay";
			};
		};
	};

	fragment@28 {
		target = <0xffffffff>;

		__overlay__ {

			camera_eeprom0@50 {
				compatible = "mediatek,camera_eeprom";
				phandle = <0x4c>;
				reg = <0x50>;
				status = "okay";
			};
		};
	};

	fragment@29 {
		target = <0xffffffff>;

		__overlay__ {

			camera_eeprom1@51 {
				compatible = "mediatek,camera_eeprom";
				phandle = <0x4d>;
				reg = <0x51>;
				status = "okay";
			};
		};
	};

	fragment@3 {
		target = <0xffffffff>;

		__overlay__ {
			mt6360pd,intr_gpio = <0xffffffff 0x9 0x0>;
			mt6360pd,intr_gpio_num = <0x9>;
		};
	};

	fragment@30 {
		target = <0xffffffff>;

		__overlay__ {

			aw36515default {
				phandle = <0xb>;
			};

			aw36515hwen_high {
				phandle = <0xc>;

				pins_cmd_dat {
					output-high;
					pinmux = <0x8600>;
					slew-rate = <0x1>;
				};
			};

			aw36515hwen_low {
				phandle = <0xd>;

				pins_cmd_dat {
					output-low;
					pinmux = <0x8600>;
					slew-rate = <0x1>;
				};
			};
		};
	};

	fragment@31 {
		target = <0xffffffff>;

		__overlay__ {

			adc_channel@ {
				compatible = "mediatek,adc_channel";
				mediatek,adc_fdd_rf_params_dynamic_custom_ch = <0x5>;
				mediatek,temperature0 = <0x0>;
				mediatek,temperature1 = <0x1>;
				status = "okay";
			};
		};
	};

	fragment@32 {
		target = <0xffffffff>;

		__overlay__ {
			io-channels = <0xffffffff 0x5>;
		};
	};

	fragment@33 {
		target = <0xffffffff>;

		__overlay__ {
			mediatek,clkbuf-config = <0x2 0x1 0x1 0x2 0x0 0x0 0x1>;
			mediatek,clkbuf-controls-for-desense = <0x0 0x4 0x0 0x4 0x0 0x0 0x0>;
			mediatek,clkbuf-output-impedance = <0x6 0x4 0x4 0x4 0x0 0x0 0x4>;
			mediatek,clkbuf-quantity = <0x7>;
			status = "okay";
		};
	};

	fragment@34 {
		target = <0xffffffff>;

		__overlay__ {
			#address-cells = <0x1>;
			#size-cells = <0x0>;
			clock-frequency = <0x61a80>;
			mediatek,use-open-drain;
		};
	};

	fragment@35 {
		target = <0xffffffff>;

		__overlay__ {
			#address-cells = <0x1>;
			#size-cells = <0x0>;
			clock-frequency = <0x1f400>;
			mediatek,use-open-drain;
		};
	};

	fragment@36 {
		target = <0xffffffff>;

		__overlay__ {
			#address-cells = <0x1>;
			#size-cells = <0x0>;
			clock-frequency = <0x61a80>;
			mediatek,use-open-drain;
		};
	};

	fragment@37 {
		target = <0xffffffff>;

		__overlay__ {
			#address-cells = <0x1>;
			#size-cells = <0x0>;
			clock-frequency = <0x61a80>;
			mediatek,use-open-drain;

			nfc@08 {
				compatible = "mediatek,nfc";
				phandle = <0x4e>;
				reg = <0x8>;
				status = "okay";
			};
		};
	};

	fragment@38 {
		target = <0xffffffff>;

		__overlay__ {
			#address-cells = <0x1>;
			#size-cells = <0x0>;
			clock-frequency = <0x61a80>;
			mediatek,use-open-drain;

			camera_main@1a {
				compatible = "mediatek,camera_main";
				phandle = <0x4f>;
				reg = <0x1a>;
				status = "okay";
			};

			camera_main_af@0c {
				compatible = "mediatek,camera_main_af";
				phandle = <0x51>;
				reg = <0xc>;
				status = "okay";
			};

			camera_main_eeprom@50 {
				compatible = "mediatek,camera_main_eeprom";
				phandle = <0x50>;
				reg = <0x50>;
				status = "okay";
			};
		};
	};

	fragment@39 {
		target = <0xffffffff>;

		__overlay__ {
			#address-cells = <0x1>;
			#size-cells = <0x0>;
			clock-frequency = <0x33e140>;
			mediatek,use-push-pull;

			subpmic@34 {
				compatible = "mediatek,subpmic";
				phandle = <0x52>;
				reg = <0x34>;
				status = "okay";
			};

			subpmic_ldo@64 {
				compatible = "mediatek,subpmic_ldo";
				phandle = <0x55>;
				reg = <0x64>;
				status = "okay";
			};

			subpmic_pmic@1a {
				compatible = "mediatek,subpmic_pmic";
				phandle = <0x54>;
				reg = <0x1a>;
				status = "okay";
			};

			usb_type_c@4e {
				compatible = "mediatek,usb_type_c";
				phandle = <0x53>;
				reg = <0x4e>;
				status = "okay";
			};
		};
	};

	fragment@4 {
		target = <0xffffffff>;

		__overlay__ {
			cv = <0x432380>;
			ieoc = <0x30d40>;
		};
	};

	fragment@40 {
		target = <0xffffffff>;

		__overlay__ {
			#address-cells = <0x1>;
			#size-cells = <0x0>;
			clock-frequency = <0x61a80>;
			mediatek,use-open-drain;

			i2c_lcd_bias@3e {
				compatible = "mediatek,i2c_lcd_bias";
				phandle = <0x57>;
				reg = <0x3e>;
				status = "okay";
			};

			strobe_main@63 {
				compatible = "mediatek,strobe_main";
				phandle = <0x56>;
				reg = <0x63>;
				status = "okay";
			};
		};
	};

	fragment@41 {
		target = <0xffffffff>;

		__overlay__ {
			#address-cells = <0x1>;
			#size-cells = <0x0>;
			clock-frequency = <0x61a80>;
			mediatek,use-open-drain;
		};
	};

	fragment@42 {
		target = <0xffffffff>;

		__overlay__ {
			#address-cells = <0x1>;
			#size-cells = <0x0>;
			clock-frequency = <0x61a80>;
			mediatek,use-open-drain;

			camera_sub@1a {
				compatible = "mediatek,camera_sub";
				phandle = <0x58>;
				reg = <0x1a>;
				status = "okay";
			};

			camera_sub_eeprom@50 {
				compatible = "mediatek,camera_sub_eeprom";
				phandle = <0x59>;
				reg = <0x50>;
				status = "okay";
			};
		};
	};

	fragment@43 {
		target = <0xffffffff>;

		__overlay__ {
			#address-cells = <0x1>;
			#size-cells = <0x0>;
			clock-frequency = <0x61a80>;
			mediatek,use-open-drain;

			camera_main_two@10 {
				compatible = "mediatek,camera_main_two";
				phandle = <0x5a>;
				reg = <0x10>;
				status = "okay";
			};
		};
	};

	fragment@44 {
		target = <0xffffffff>;

		__overlay__ {
			GPIO_RF_PWREN_RST_PIN = <0xffffffff 0xaa 0x0>;
			GPIO_SIM1_HOT_PLUG = <0xffffffff 0x4d 0x0>;
			GPIO_SIM1_SCLK = <0xffffffff 0x7c 0x0>;
			GPIO_SIM1_SIO = <0xffffffff 0x7a 0x0>;
			GPIO_SIM1_SRST = <0xffffffff 0x7b 0x0>;
			GPIO_SIM2_SCLK = <0xffffffff 0x77 0x0>;
			GPIO_SIM2_SIO = <0xffffffff 0x79 0x0>;
			GPIO_SIM2_SRST = <0xffffffff 0x78 0x0>;
		};
	};

	fragment@45 {
		target = <0xffffffff>;

		__overlay__ {
			gpio_init_default = <0x0 0x0 0x0 0x0 0x1 0x0 0x1 0x1 0x0 0x0 0x0 0x1 0x1 0x1 0x2 0x0 0x0 0x0 0x1 0x1 0x1 0x3 0x0 0x0 0x0 0x1 0x0 0x1 0x4 0x0 0x0 0x0 0x1 0x1 0x1 0x5 0x0 0x0 0x0 0x1 0x0 0x1 0x6 0x0 0x1 0x0 0x1 0x0 0x1 0x7 0x0 0x1 0x0 0x1 0x0 0x1 0x8 0x7 0x0 0x0 0x1 0x0 0x1 0x9 0x0 0x0 0x0 0x1 0x1 0x1 0xa 0x0 0x0 0x0 0x1 0x1 0x1 0xb 0x0 0x0 0x0 0x1 0x1 0x1 0xc 0x2 0x0 0x0 0x1 0x0 0x1 0xd 0x0 0x0 0x0 0x0 0x0 0x1 0xe 0x0 0x0 0x0 0x1 0x1 0x1 0xf 0x0 0x1 0x0 0x1 0x0 0x1 0x10 0x7 0x0 0x0 0x1 0x0 0x1 0x11 0x0 0x0 0x0 0x0 0x0 0x1 0x12 0x7 0x0 0x0 0x1 0x0 0x1 0x13 0x7 0x0 0x0 0x0 0x0 0x1 0x14 0x0 0x1 0x0 0x1 0x0 0x1 0x15 0x0 0x1 0x1 0x1 0x0 0x1 0x16 0x0 0x0 0x0 0x1 0x0 0x1 0x17 0x1 0x0 0x0 0x1 0x0 0x1 0x18 0x1 0x0 0x0 0x1 0x0 0x1 0x19 0x1 0x0 0x0 0x1 0x0 0x1 0x1a 0x1 0x0 0x0 0x1 0x0 0x1 0x1b 0x1 0x0 0x0 0x0 0x0 0x1 0x1c 0x1 0x0 0x0 0x0 0x0 0x1 0x1d 0x1 0x0 0x0 0x0 0x0 0x1 0x1e 0x1 0x0 0x0 0x1 0x0 0x1 0x1f 0x2 0x0 0x0 0x0 0x0 0x1 0x20 0x2 0x0 0x0 0x0 0x0 0x1 0x21 0x2 0x0 0x0 0x0 0x0 0x1 0x22 0x2 0x0 0x0 0x1 0x0 0x1 0x23 0x4 0x0 0x0 0x1 0x1 0x1 0x24 0x4 0x0 0x0 0x0 0x0 0x1 0x25 0x4 0x0 0x0 0x0 0x0 0x1 0x26 0x4 0x0 0x0 0x1 0x1 0x1 0x27 0x0 0x0 0x0 0x1 0x1 0x1 0x28 0x1 0x0 0x0 0x0 0x0 0x1 0x29 0x1 0x0 0x0 0x0 0x0 0x1 0x2a 0x1 0x0 0x0 0x1 0x0 0x1 0x2b 0x1 0x0 0x0 0x0 0x0 0x1 0x2c 0x0 0x0 0x0 0x1 0x0 0x1 0x2d 0x0 0x1 0x1 0x1 0x0 0x1 0x2e 0x0 0x0 0x0 0x1 0x0 0x1 0x2f 0x0 0x0 0x0 0x1 0x0 0x1 0x30 0x0 0x0 0x0 0x1 0x0 0x1 0x31 0x1 0x0 0x0 0x0 0x0 0x1 0x32 0x1 0x0 0x0 0x0 0x0 0x1 0x33 0x1 0x0 0x0 0x0 0x0 0x1 0x34 0x1 0x0 0x0 0x0 0x0 0x1 0x35 0x0 0x1 0x0 0x1 0x0 0x1 0x36 0x0 0x1 0x0 0x1 0x0 0x1 0x37 0x0 0x1 0x0 0x1 0x0 0x1 0x38 0x0 0x1 0x0 0x1 0x0 0x1 0x39 0x0 0x1 0x0 0x1 0x0 0x1 0x3a 0x0 0x1 0x0 0x1 0x0 0x1 0x3b 0x0 0x1 0x0 0x1 0x0 0x1 0x3c 0x0 0x1 0x0 0x1 0x0 0x1 0x3d 0x1 0x0 0x0 0x1 0x1 0x1 0x3e 0x1 0x0 0x0 0x0 0x0 0x1 0x3f 0x0 0x0 0x0 0x1 0x1 0x1 0x40 0x1 0x0 0x0 0x0 0x0 0x1 0x4d 0x1 0x0 0x0 0x1 0x1 0x1 0x4e 0x0 0x0 0x0 0x1 0x0 0x1 0x4f 0x1 0x0 0x0 0x1 0x1 0x1 0x50 0x1 0x0 0x0 0x1 0x1 0x1 0x51 0x3 0x0 0x0 0x1 0x0 0x1 0x52 0x1 0x0 0x0 0x1 0x1 0x1 0x53 0x1 0x0 0x0 0x0 0x0 0x1 0x54 0x1 0x0 0x0 0x1 0x0 0x0 0x55 0x1 0x0 0x0 0x1 0x0 0x0 0x56 0x0 0x1 0x0 0x1 0x0 0x0 0x57 0x0 0x1 0x0 0x1 0x0 0x1 0x58 0x0 0x0 0x0 0x1 0x0 0x1 0x59 0x0 0x0 0x0 0x1 0x0 0x1 0x5a 0x1 0x0 0x0 0x0 0x0 0x1 0x5b 0x0 0x0 0x0 0x1 0x0 0x1 0x5c 0x0 0x1 0x0 0x1 0x0 0x1 0x5d 0x0 0x1 0x0 0x1 0x0 0x1 0x5e 0x0 0x1 0x0 0x1 0x0 0x1 0x5f 0x1 0x0 0x0 0x1 0x0 0x1 0x60 0x1 0x0 0x0 0x1 0x0 0x1 0x61 0x1 0x0 0x0 0x1 0x1 0x1 0x62 0x1 0x0 0x0 0x1 0x1 0x1 0x63 0x2 0x0 0x0 0x1 0x1 0x1 0x64 0x2 0x0 0x0 0x1 0x1 0x1 0x65 0x1 0x0 0x0 0x1 0x1 0x1 0x66 0x1 0x0 0x0 0x1 0x1 0x1 0x67 0x1 0x0 0x0 0x1 0x1 0x1 0x68 0x1 0x0 0x0 0x1 0x1 0x1 0x69 0x1 0x0 0x0 0x1 0x1 0x1 0x6a 0x1 0x0 0x0 0x1 0x1 0x1 0x6b 0x1 0x0 0x0 0x1 0x1 0x1 0x6c 0x1 0x0 0x0 0x1 0x1 0x1 0x6d 0x1 0x0 0x0 0x1 0x1 0x1 0x6e 0x1 0x0 0x0 0x1 0x1 0x1 0x6f 0x7 0x0 0x0 0x1 0x0 0x1 0x70 0x7 0x0 0x0 0x1 0x0 0x1 0x71 0x1 0x0 0x0 0x1 0x1 0x1 0x72 0x1 0x0 0x0 0x1 0x1 0x1 0x73 0x1 0x0 0x0 0x1 0x0 0x1 0x74 0x1 0x0 0x0 0x1 0x0 0x1 0x75 0x0 0x0 0x0 0x1 0x0 0x1 0x76 0x0 0x0 0x0 0x1 0x0 0x1 0x77 0x1 0x0 0x0 0x0 0x0 0x1 0x78 0x1 0x0 0x0 0x0 0x0 0x1 0x79 0x1 0x0 0x0 0x1 0x1 0x1 0x7a 0x1 0x0 0x0 0x1 0x1 0x1 0x7b 0x1 0x0 0x0 0x0 0x0 0x1 0x7c 0x1 0x0 0x0 0x0 0x0 0x1 0x7d 0x1 0x0 0x0 0x0 0x0 0x1 0x7e 0x1 0x0 0x0 0x1 0x1 0x1 0x7f 0x1 0x0 0x0 0x1 0x1 0x1 0x80 0x1 0x0 0x0 0x1 0x1 0x1 0x81 0x1 0x0 0x0 0x1 0x1 0x1 0x82 0x1 0x0 0x0 0x1 0x1 0x1 0x83 0x0 0x1 0x0 0x1 0x0 0x1 0x84 0x0 0x1 0x0 0x1 0x0 0x1 0x85 0x0 0x1 0x0 0x1 0x0 0x1 0x86 0x0 0x1 0x0 0x1 0x0 0x1 0x87 0x0 0x1 0x0 0x1 0x0 0x1 0x88 0x0 0x1 0x1 0x1 0x0 0x1 0x89 0x0 0x1 0x0 0x1 0x0 0x1 0x8a 0x0 0x1 0x0 0x1 0x0 0x1 0x8b 0x0 0x1 0x0 0x1 0x0 0x1 0x8c 0x0 0x1 0x0 0x1 0x0 0x1 0x8d 0x1 0x0 0x0 0x1 0x0 0x1 0x8e 0x1 0x0 0x0 0x1 0x0 0x1 0x8f 0x1 0x0 0x0 0x0 0x0 0x1 0x90 0x1 0x0 0x0 0x0 0x0 0x1 0x91 0x1 0x0 0x0 0x0 0x0 0x1 0x92 0x1 0x0 0x0 0x0 0x0 0x1 0x93 0x1 0x0 0x0 0x0 0x0 0x1 0x94 0x1 0x0 0x0 0x0 0x0 0x1 0x95 0x1 0x0 0x0 0x1 0x0 0x1 0x96 0x1 0x0 0x0 0x1 0x0 0x1 0x97 0x1 0x0 0x0 0x1 0x0 0x1 0x98 0x1 0x0 0x0 0x1 0x0 0x1 0x99 0x1 0x0 0x0 0x0 0x0 0x1 0x9a 0x1 0x0 0x0 0x0 0x0 0x1 0x9b 0x1 0x0 0x0 0x0 0x0 0x1 0x9c 0x1 0x0 0x0 0x0 0x0 0x1 0x9d 0x1 0x0 0x0 0x0 0x0 0x1 0x9e 0x1 0x0 0x0 0x0 0x0 0x1 0x9f 0x1 0x0 0x0 0x1 0x0 0x1 0xa0 0x1 0x0 0x0 0x1 0x0 0x1 0xa1 0x1 0x0 0x0 0x1 0x0 0x1 0xa2 0x1 0x0 0x0 0x0 0x0 0x0 0xa3 0x1 0x0 0x0 0x1 0x0 0x0 0xa4 0x1 0x0 0x0 0x1 0x0 0x1 0xa5 0x1 0x0 0x0 0x1 0x0 0x1 0xa6 0x1 0x0 0x0 0x0 0x0 0x1 0xa7 0x1 0x0 0x0 0x0 0x0 0x1 0xa8 0x1 0x0 0x0 0x0 0x0 0x1 0xa9 0x1 0x0 0x0 0x0 0x0 0x1 0xaa 0x0 0x1 0x1 0x1 0x0 0x1 0xab 0x1 0x0 0x0 0x0 0x0 0x1 0xac 0x1 0x0 0x0 0x0 0x0 0x1 0xad 0x1 0x0 0x0 0x0 0x0 0x1 0xae 0x1 0x0 0x0 0x0 0x0 0x1 0xaf 0x1 0x0 0x0 0x0 0x0 0x1 0xb0 0x1 0x0 0x0 0x0 0x0 0x1 0xb1 0x1 0x0 0x0 0x0 0x0 0x1 0xb2 0x1 0x0 0x0 0x0 0x0 0x1 0xb3 0x1 0x0 0x0 0x0 0x0 0x1 0xb4 0x1 0x0 0x0 0x0 0x0 0x1 0xb5 0x1 0x0 0x0 0x0 0x0 0x1 0xb6 0x1 0x0 0x0 0x0 0x0 0x1 0xb7 0x1 0x0 0x0 0x0 0x0 0x1 0xb8 0x1 0x0 0x0 0x0 0x0 0x1 0xb9 0x1 0x0 0x0 0x0 0x0 0x1 0xba 0x1 0x0 0x0 0x0 0x0 0x1 0xbb 0x1 0x0 0x0 0x0 0x0 0x1 0xbc 0x1 0x0 0x0 0x0 0x0 0x0 0xbd 0x1 0x0 0x0 0x1 0x0 0x0 0xbe 0x1 0x0 0x0 0x0 0x0 0x0 0xbf 0x1 0x0 0x0 0x1 0x0 0x0 0xc0 0x0 0x0 0x0 0x1 0x0 0x1 0xc1 0x0 0x0 0x0 0x1 0x0 0x1 0xc2 0x0 0x0 0x0 0x1 0x0 0x1 0xc3 0x0 0x0 0x0 0x1 0x0 0x1 0xc4 0x0 0x0 0x0 0x1 0x0 0x1 0xc5 0x0 0x0 0x0 0x1 0x0 0x1 0xc6 0x0 0x0 0x0 0x1 0x0 0x1 0xc7 0x0 0x0 0x0 0x1 0x0 0x1 0xc8 0x0 0x0 0x0 0x1 0x0 0x1>;
		};
	};

	fragment@46 {
		target = <0xffffffff>;

		__overlay__ {
			deb-gpios = <0xffffffff 0x1 0x0>;
			debounce = <0x3e8>;
			interrupt-parent = <0xffffffff>;
			interrupts = <0x1 0x8>;
			status = "okay";
		};
	};

	fragment@47 {
		target = <0xffffffff>;

		__overlay__ {
			deb-gpios = <0xffffffff 0x4 0x0>;
			debounce = <0x186a0>;
			interrupt-parent = <0xffffffff>;
			interrupts = <0x4 0x4>;
			status = "okay";
		};
	};

	fragment@48 {
		target = <0xffffffff>;

		__overlay__ {
			interrupt-parent = <0xffffffff>;
			interrupts = <0xa 0x2>;
			status = "okay";
		};
	};

	fragment@49 {
		target = <0xffffffff>;

		__overlay__ {
			interrupt-parent = <0xffffffff>;
			interrupts = <0xe 0x2>;
			status = "okay";
		};
	};

	fragment@5 {
		target = <0xffffffff>;

		__overlay__ {

			dispdefault {
				phandle = <0x1>;
			};

			lcd_bias_enn0_gpio {
				phandle = <0x6>;

				pins_cmd_dat {
					output-low;
					pinmux = <0x8400>;
					slew-rate = <0x1>;
				};
			};

			lcd_bias_enn1_gpio {
				phandle = <0x7>;

				pins_cmd_dat {
					output-high;
					pinmux = <0x8400>;
					slew-rate = <0x1>;
				};
			};

			lcd_bias_enp0_gpio {
				phandle = <0x4>;

				pins_cmd_dat {
					output-low;
					pinmux = <0x8a00>;
					slew-rate = <0x1>;
				};
			};

			lcd_bias_enp1_gpio {
				phandle = <0x5>;

				pins_cmd_dat {
					output-high;
					pinmux = <0x8a00>;
					slew-rate = <0x1>;
				};
			};

			lcm_rst_out0_gpio {
				phandle = <0x2>;

				pins_cmd_dat {
					output-low;
					pinmux = <0x5600>;
					slew-rate = <0x1>;
				};
			};

			lcm_rst_out1_gpio {
				phandle = <0x3>;

				pins_cmd_dat {
					output-high;
					pinmux = <0x5600>;
					slew-rate = <0x1>;
				};
			};
		};
	};

	fragment@50 {
		target = <0xffffffff>;

		__overlay__ {
			interrupt-parent = <0xffffffff>;
			interrupts = <0x54 0x1>;
			status = "okay";
		};
	};

	fragment@51 {
		target = <0xffffffff>;

		__overlay__ {
			compatible = "mediatek,md1_sim1_hot_plug_eint-eint";
			debounce = <0x0 0x4e20>;
			dedicated = <0x0 0x0>;
			interrupts = <0x0 0x8>;
			sockettype = <0x0 0x0>;
			src_pin = <0x0 0x1>;
			status = "okay";
		};
	};

	fragment@52 {
		target = <0xffffffff>;

		__overlay__ {
			regulator-default-on = <0x1>;
			regulator-name = "vcamio";
			status = "okay";
		};
	};

	fragment@53 {
		target = <0xffffffff>;

		__overlay__ {
			regulator-default-on = <0x1>;
			regulator-name = "vtp";
			status = "okay";
		};
	};

	fragment@54 {
		target = <0xffffffff>;

		__overlay__ {
			status = "okay";
			vcamio-supply = <0xffffffff>;
			vcamio_sub-supply = <0xffffffff>;
		};
	};

	fragment@55 {
		target = <0xffffffff>;

		__overlay__ {
			status = "okay";
			vtouch-supply = <0xffffffff>;
		};
	};

	fragment@56 {
		target = <0xffffffff>;

		__overlay__ {
			mediatek,kpd-hw-dl-key0 = <0x0>;
			mediatek,kpd-hw-dl-key1 = <0x1>;
			mediatek,kpd-hw-dl-key2 = <0x8>;
			mediatek,kpd-hw-factory-key = <0x1>;
			mediatek,kpd-hw-init-map = <0x73 0x72 0x0 0x0 0x0 0x0 0x0 0x0 0x0 0x0 0x0 0x0 0x0 0x0 0x0 0x0 0x0 0x0 0x0 0x0 0x0 0x0 0x0 0x0 0x0 0x0 0x0 0x0 0x0 0x0 0x0 0x0 0x0 0x0 0x0 0x0 0x0 0x0 0x0 0x0 0x0 0x0 0x0 0x0 0x0 0x0 0x0 0x0 0x0 0x0 0x0 0x0 0x0 0x0 0x0 0x0 0x0 0x0 0x0 0x0 0x0 0x0 0x0 0x0 0x0 0x0 0x0 0x0 0x0 0x0 0x0 0x0>;
			mediatek,kpd-hw-map-num = <0x48>;
			mediatek,kpd-hw-pwrkey = <0x8>;
			mediatek,kpd-hw-recovery-key = <0x0>;
			mediatek,kpd-key-debounce = <0x400>;
			mediatek,kpd-pwkey-gpio-din = <0x0>;
			mediatek,kpd-pwrkey-eint-gpio = <0x0>;
			mediatek,kpd-sw-pwrkey = <0x74>;
			mediatek,kpd-use-extend-type = <0x0>;
			status = "okay";
		};
	};

	fragment@6 {
		target = <0xffffffff>;

		__overlay__ {
			pinctrl-0 = <0x1>;
			pinctrl-1 = <0x2>;
			pinctrl-2 = <0x3>;
			pinctrl-3 = <0x4>;
			pinctrl-4 = <0x5>;
			pinctrl-5 = <0x6>;
			pinctrl-6 = <0x7>;
			pinctrl-names = "dispdefault", "lcm_rst_out0_gpio", "lcm_rst_out1_gpio", "lcd_bias_enp0_gpio", "lcd_bias_enp1_gpio", "lcd_bias_enn0_gpio", "lcd_bias_enn1_gpio";
			status = "okay";
		};
	};

	fragment@7 {
		target = <0xffffffff>;

		__overlay__ {
			#address-cells = <0x1>;
			#size-cells = <0x0>;
			status = "okay";

			panel1@0 {
				bias-gpios = <0xffffffff 0x8a 0x0 0xffffffff 0x84 0x0>;
				compatible = "icnl9916,hdp,dsi,vdo,coe,boe,p661n";
				pinctrl-names = "default";
				reg = <0x0>;
				reset-gpios = <0xffffffff 0x56 0x0>;

				port {

					endpoint {
						phandle = <0x9>;
						remote-endpoint = <0x8>;
					};
				};
			};

			ports {

				port {

					endpoint {
						phandle = <0x8>;
						remote-endpoint = <0x9>;
					};
				};
			};
		};
	};

	fragment@8 {
		target = <0xffffffff>;

		__overlay__ {
			pinctrl-0 = <0xa>;
			pinctrl-names = "default";
		};
	};

	fragment@9 {
		target = <0xffffffff>;

		__overlay__ {

			kpdgpiodefault {
				phandle = <0xa>;

				pins_cmd_dat {
					bias-pull-up = <0x66>;
					input-schmitt-enable;
					output-low;
					pinmux = <0x4f01>;
				};
			};
		};
	};
};
